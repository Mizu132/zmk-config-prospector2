/ {
    /* Step 1: Wipe the default listener that binds exclusively to the "S" variant */
    /delete-node/ touch_listener;
};

&i2c0 {
    status = "okay";
    /* Step 2: Delete the baseline driver configuration entirely */
    /delete-node/ cst816s@15; 

    /* Step 3: Instantiate a relaxed registration node */
    touch_sensor: cst816s@15 {
        compatible = "hynitron,cst816s";
        reg = <0x15>;
        status = "okay";
        irq-gpios = <&gpio0 2 (GPIO_ACTIVE_LOW | GPIO_PULL_UP)>; /* Forces clear interrupt polling */
        rst-gpios = <&gpio0 3 GPIO_ACTIVE_LOW>;
    };
};

/ {
    /* Step 4: Rebuild the listener directly mapped to our relaxed node */
    touch_listener: touch_listener {
        status = "okay";
        compatible = "zmk,input-listener";
        device = <&touch_sensor>;
    };
};
