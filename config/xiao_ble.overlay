&i2c0 {
    status = "okay";
    clock-frequency = <100000>;

    cst816s@15 {
        compatible = "hynitron,cst816s";
        reg = <0x15>;
        irq-gpios = <&gpio0 2 (GPIO_ACTIVE_LOW | GPIO_PULL_UP)>;   /* D0 is P0.02 on XIAO BLE */
        rst-gpios = <&gpio1 11 GPIO_ACTIVE_LOW>;                  /* D1 is P1.11 on XIAO BLE */
    };
};
